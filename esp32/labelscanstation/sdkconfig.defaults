## esp32/usb_test/sdkconfig.defaults
```kconfig
CONFIG_USB_OTG_SUPPORTED=y
CONFIG_USJ_ENABLE_USB_SERIAL_JTAG=n
CONFIG_ESP_CONSOLE_SECONDARY_NONE=y
CONFIG_ESP_CONSOLE_UART_DEFAULT=y
CONFIG_ESP_CONSOLE_UART_NUM=0
CONFIG_ESP_CONSOLE_UART_BAUDRATE=115200
CONFIG_COMPILER_WARN_WRITE_STRINGS=n
```
